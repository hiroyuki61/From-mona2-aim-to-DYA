## boards/shields/mona2/Kconfig.defconfig
```kconfig
if SHIELD_MONA2_R

config ZMK_KEYBOARD_NAME
    string
    default "moNa2"

config ZMK_BLE
    bool        # ← これを追加
    default y

config ZMK_SPLIT_ROLE_CENTRAL
    bool        # ← これを追加
    default y

config INPUT
    bool        # ← これを追加
    default y

config ZMK_POINTING
    bool        # ← これを追加
    default y

config SPI
    bool        # ← これを追加
    default y

config PMW3610
    bool        # ← これを追加
    default y

endif

if SHIELD_MONA2_R || SHIELD_MONA2_L

config NFCT_PINS_AS_GPIOS
    bool        # ← これを追加
    default y

config ZMK_SPLIT
    bool        # ← これを追加
    default y

config RGBLED_WIDGET_BATTERY_LEVEL_HIGH
    int "Battery High Level"
    default 30

config RGBLED_WIDGET_BATTERY_LEVEL_CRITICAL
    int "Battery Critical Level"
    default 10

endif
```
